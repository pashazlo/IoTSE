#include "tx_hal_80211.h"

#include "esp_wifi.h" /* esp_wifi_80211_tx, wifi_interface_t, WIFI_IF_STA */
#include "esp_log.h"
#include <stdint.h> 

static const char *TAG = "TX_HAL";

/* Внутри esp_wifi_80211_tx драйвер зовёт проверку ieee80211_raw_frame_sanity_check,
 * которая режет «служебные» кадры вроде deauth ("unsupport frame type: 0c0").
 *
 * КАК ОБХОДИМ. Объявляем СВОЮ функцию с тем же именем, всегда разрешающую кадр
 * (возврат 0). В libnet80211 такой символ уже есть и он «сильный» → возник бы
 * конфликт (multiple definition). Решаем флагом компоновщика
 * -Wl,--allow-multiple-definition (см. CMakeLists): линкер берёт ПЕРВОЕ по
 * порядку определение, а наш компонент линкуется раньше системных либ IDF —
 * значит выбирается наша версия. Ссылка на символ глобальная, поэтому даже
 * внутренний вызов драйвера указывает на нашу функцию.
 *
 * Почему не сработал --wrap: esp_wifi_80211_tx и проверка лежат в ОДНОМ объектном
 * файле (ieee80211_output.o); --wrap оборачивает только внешние ссылки, а вызов
 * внутри одного .o остаётся локальным и проходит мимо обёртки.
 *
 * Только для авторизованного тестирования на своём оборудовании. Касается лишь TX
 * сырых кадров; на RX/обычный Wi-Fi не влияет. */

int ieee80211_raw_frame_sanity_check(int32_t arg, int32_t arg2, int32_t arg3)

{
    (void)arg; (void)arg2; (void)arg3;
    return 0; /* 0 = разрешить передачу */
}

esp_err_t tx_hal_80211_send(const uint8_t *frame, size_t length,
                            bool use_system_sequence)
{
    /* Шаг 1. Проверяем аргументы ДО обращения к драйверу — так ошибку видно
     * сразу и с понятным кодом, а не как невнятный сбой внутри esp_wifi. */
    if (frame == NULL) {
        return ESP_ERR_INVALID_ARG;
    }
    if (length < TX_HAL_80211_MIN_LEN || length > TX_HAL_80211_MAX_LEN) {
        return ESP_ERR_INVALID_SIZE;
    }

    /* Шаг 2. Отдаём кадр драйверу.
     *
     * WIFI_IF_STA: в этой прошивке радио поднимается как станция (STA) — именно
     * STA-интерфейс активен и в обычном режиме, и во время promiscuous-захвата.
     * Поэтому инъекцию делаем через него; передача уйдёт на текущем канале
     * радио (канал задаётся отдельно, не здесь).
     *
     * Приведение length (size_t) к int безопасно: выше мы гарантировали
     * length <= TX_HAL_80211_MAX_LEN (1500), что заведомо помещается в int и не
     * переполняет его.
     *
     * Буфер frame esp_wifi_80211_tx копирует внутрь себя до возврата, поэтому
     * после этого вызова наш буфер больше не нужен — держать его живым не надо. */
    esp_err_t err = esp_wifi_80211_tx(WIFI_IF_STA, frame, (int)length,
                                      use_system_sequence);

    /* Шаг 3. На ошибке оставляем след в логе (имя кода, не сам кадр — payload в
     * лог не пишем). Возвращаем результат как есть: решать, что делать с ошибкой,
     * будет слой выше (TX worker), у этого примитива политики нет. */
    if (err != ESP_OK) {
        ESP_LOGW(TAG, "esp_wifi_80211_tx failed: %s", esp_err_to_name(err));
    }
    return err;
}
